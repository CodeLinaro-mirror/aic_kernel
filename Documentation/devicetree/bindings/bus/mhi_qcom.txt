## Documentation/devicetree/bindings/bus/mhi_qcom.txt
```
Qualcomm Technologies Inc MHI Bus controller

MHI control driver enables clients to communicate with external mode
using MHI protocol.

==============
Node Structure
==============

Main node properties:

- reg
  Usage: required
  Value type: Array (5-cell PCI resource) of <u32>
  Definition: First cell is devfn, which is determined by pci bus topology.
	Assign the other cells 0 since they are not used.

- qcom,smmu-cfg
  Usage: required
  Value type: <u32>
  Definition: Required SMMU configuration bitmask for PCIe bus.
	BIT mask:
	BIT(0) : Attach address mapping to endpoint device
	BIT(1) : Set attribute S1_BYPASS
	BIT(2) : Set attribute FAST
	BIT(3) : Set attribute ATOMIC
	BIT(4) : Set attribute FORCE_COHERENT

- qcom,addr-win
  Usage: required if SMMU S1 translation is enabled
  Value type: Array of <u64>
  Definition: Pair of values describing iova start and stop address

- MHI bus settings
  Usage: required
  Values: as defined by mhi.txt
  Definition: Per definition of devicetree/bindings/bus/mhi.txt, define device
	specific MHI configuration parameters.

========
Example:
========

/* pcie domain (root complex) modem connected to */
&pcie1 {
	/* pcie bus modem connected to */
	pci,bus@1 {
		reg = <0 0 0 0 0>;

		qcom,mhi {
			reg = <0 0 0 0 0>;
			qcom,smmu-cfg = <0x3d>;
			qcom,addr-win = <0x0 0x20000000 0x0 0x3fffffff>;

			<mhi bus configurations>
		};
	};
};
```

## drivers/bus/mhi/devices/Kconfig
```kconfig
menu "MHI device support"

config MHI_UCI
       tristate "MHI UCI"
       depends on MHI_BUS
       help
	  MHI based uci driver is for transferring data between host and
	  modem using standard file operations from user space. Open, read,
	  write, ioctl, and close operations are supported by this driver.
	  Please check mhi_uci_match_table for all supported channels that
	  are exposed to userspace.

endmenu
```
